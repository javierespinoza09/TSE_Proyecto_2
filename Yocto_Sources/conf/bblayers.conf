## Yocto_Sources/conf/bblayers.conf
```bitbake
# POKY_BBLAYERS_CONF_VERSION is increased each time build/conf/bblayers.conf
# changes incompatibly
POKY_BBLAYERS_CONF_VERSION = "2"

BBPATH = "${TOPDIR}"
BBFILES ?= ""

BBLAYERS ?= " \
  /home/javierespinoza/poky/meta \
  /home/javierespinoza/poky/meta-poky \
  /home/javierespinoza/poky/meta-yocto-bsp \
  /home/javierespinoza/Yocto/meta-raspberrypi \
  /home/javierespinoza/Yocto/meta-emotion \
  /home/javierespinoza/Yocto/meta-openembedded/meta-oe \
  /home/javierespinoza/Yocto/meta-openembedded/meta-python \
  /home/javierespinoza/Yocto/meta-openembedded/meta-networking \
  /home/javierespinoza/Yocto/meta-openembedded/meta-multimedia \
  /home/javierespinoza/Yocto/meta-tensorflow \
  "
```
